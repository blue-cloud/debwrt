## Config.in
```kconfig
# DebWrt - Debian on Embedded devices
#
# Copyright (C) 2012 Johan van Zoomeren <amain@debwrt.net>
#
# This program is free software: you can redistribute it and/or modify
# it under the terms of the GNU General Public License as published by
# the Free Software Foundation, either version 3 of the License, or
# (at your option) any later version.
#
# This program is distributed in the hope that it will be useful,
# but WITHOUT ANY WARRANTY; without even the implied warranty of
# MERCHANTABILITY or FITNESS FOR A PARTICULAR PURPOSE.  See the
# GNU General Public License for more details.
#
# You should have received a copy of the GNU General Public License
# along with this program.  If not, see <http://www.gnu.org/licenses/>.

# Kconfig documentation: http://lxr.linux.no/#linux+v2.6.34.1/Documentation/kbuild/kconfig-language.txt

config HAVE_DOT_CONFIG
        bool
        default y

config HAS_SUBTARGETS
        bool

config DO_CONF_TARGETS
	bool
	default y

config DO_CONF_OPENWRT_REVISON
	bool
	default y

config ALT_TARGET
	bool
	default n

#config DO_CONF_FLASH_IP
#	bool
#	default y

#config DO_CONF_TARGET_IMAGE_NAME_TRX
#	bool
#	default y

mainmenu "DebWrt Configuration"

source "config/plugin.in"

source "config/archs.in"
source "config/target.in"

source "config/image_name.in"
source "config/flash_ip.in"

source "config/openwrt_version.in"
source "config/openwrt_extra.in"

source "config/kernel_version.in"
source "config/kernel_config.in"

source "config/debian_cross.in"
source "config/debian_rootfs.in"

source "config/debwrt_general.in"
source "config/debwrt_boot.in"

# End of file
```

## config/openwrt.defconfig
```kconfig
# DebWrt - Debian on Embedded devices
#
# Copyright (C) 2010 Johan van Zoomeren <amain@debwrt.net>
#
# This program is free software: you can redistribute it and/or modify
# it under the terms of the GNU General Public License as published by
# the Free Software Foundation, either version 3 of the License, or
# (at your option) any later version.
#
# This program is distributed in the hope that it will be useful,
# but WITHOUT ANY WARRANTY; without even the implied warranty of
# MERCHANTABILITY or FITNESS FOR A PARTICULAR PURPOSE.  See the
# GNU General Public License for more details.
#
# You should have received a copy of the GNU General Public License
# along with this program.  If not, see <http://www.gnu.org/licenses/>.

# Required default config
#
CONFIG_TARGET_ROOTFS_INITRAMFS=n
CONFIG_TARGET_ROOTFS_JFFS2=n
CONFIG_TARGET_ROOTFS_SQUASHFS=y
CONFIG_TARGET_ROOTFS_TGZ=n
CONFIG_TARGET_ROOTFS_CPIOGZ=n
CONFIG_TARGET_ROOTFS_EXT2FS=n
CONFIG_KERNEL_DEBUG_FS=n

# Fix dependency problem ( host opkg is required, but not build when base-files is not build )
#
CONFIG_PACKAGE_base-files=y

# DebWrt distribution config
#
CONFIG_PACKAGE_kmod-loop=y
CONFIG_PACKAGE_kmod-nbd=y
CONFIG_PACKAGE_kmod-crypto-des=y
CONFIG_PACKAGE_kmod-crypto-hmac=y
CONFIG_PACKAGE_kmod-crypto-md5=y
CONFIG_PACKAGE_kmod-crypto-misc=y
CONFIG_PACKAGE_kmod-crypto-sha1=y
CONFIG_PACKAGE_kmod-fs-btrfs=y
CONFIG_PACKAGE_kmod-fs-cifs=y
CONFIG_PACKAGE_kmod-fs-exportfs=y
CONFIG_PACKAGE_kmod-fs-ext2=y
CONFIG_PACKAGE_kmod-fs-ext3=y
CONFIG_PACKAGE_kmod-fs-ext4=y
CONFIG_PACKAGE_kmod-fs-hfs=y
CONFIG_PACKAGE_kmod-fs-hfsplus=y
CONFIG_PACKAGE_kmod-fs-isofs=y
CONFIG_PACKAGE_kmod-fs-mbcache=y
CONFIG_PACKAGE_kmod-fs-minix=y
CONFIG_PACKAGE_kmod-fs-msdos=y
CONFIG_PACKAGE_kmod-fs-nfs=y
CONFIG_PACKAGE_kmod-fs-nfs-common=y
CONFIG_PACKAGE_kmod-fs-nfsd=y
CONFIG_PACKAGE_kmod-fs-ntfs=y
CONFIG_PACKAGE_kmod-fs-reiserfs=y
CONFIG_PACKAGE_kmod-fs-udf=y
CONFIG_PACKAGE_kmod-fs-vfat=y
CONFIG_PACKAGE_kmod-fs-xfs=y
CONFIG_PACKAGE_kmod-fuse=y
CONFIG_PACKAGE_kmod-i2c-core=y
CONFIG_PACKAGE_kmod-nls-base=y
CONFIG_PACKAGE_kmod-nls-cp1250=y
CONFIG_PACKAGE_kmod-nls-cp1251=y
CONFIG_PACKAGE_kmod-nls-cp437=y
CONFIG_PACKAGE_kmod-nls-cp775=y
CONFIG_PACKAGE_kmod-nls-cp850=y
CONFIG_PACKAGE_kmod-nls-cp852=y
CONFIG_PACKAGE_kmod-nls-cp866=y
CONFIG_PACKAGE_kmod-nls-iso8859-1=y
CONFIG_PACKAGE_kmod-nls-iso8859-13=y
CONFIG_PACKAGE_kmod-nls-iso8859-15=y
CONFIG_PACKAGE_kmod-nls-iso8859-2=y
CONFIG_PACKAGE_kmod-nls-koi8r=y
CONFIG_PACKAGE_kmod-nls-utf8=y
CONFIG_PACKAGE_kmod-arptables=y
CONFIG_PACKAGE_kmod-ebtables=y
CONFIG_PACKAGE_kmod-ebtables-ipv4=y
CONFIG_PACKAGE_kmod-ebtables-ipv6=y
CONFIG_PACKAGE_kmod-ebtables-watchers=y
CONFIG_PACKAGE_kmod-ip6tables=y
CONFIG_PACKAGE_kmod-ipt-core=y
CONFIG_PACKAGE_kmod-ipt-conntrack=y
CONFIG_PACKAGE_kmod-ipt-conntrack-extra=y
CONFIG_PACKAGE_kmod-ipt-extra=y
CONFIG_PACKAGE_kmod-ipt-filter=y
CONFIG_PACKAGE_kmod-ipt-imq=y
CONFIG_PACKAGE_kmod-ipt-ipopt=y
CONFIG_PACKAGE_kmod-ipt-iprange=y
CONFIG_PACKAGE_kmod-ipt-ipsec=y
CONFIG_PACKAGE_kmod-ipt-ipset=y
CONFIG_PACKAGE_kmod-ipt-nat=y
CONFIG_PACKAGE_kmod-ipt-nat-extra=y
CONFIG_PACKAGE_kmod-ipt-nathelper=y
CONFIG_PACKAGE_kmod-ipt-nathelper-extra=y
CONFIG_PACKAGE_kmod-ipt-queue=y
CONFIG_PACKAGE_kmod-ipt-tproxy=y
CONFIG_PACKAGE_kmod-ipt-ulog=y
CONFIG_PACKAGE_kmod-nf-conntrack-netlink=y
CONFIG_PACKAGE_kmod-nfnetlink=y
CONFIG_PACKAGE_kmod-nfnetlink-log=y
CONFIG_PACKAGE_kmod-nfnetlink-queue=y
CONFIG_PACKAGE_kmod-libphy=y
CONFIG_PACKAGE_kmod-macvlan=y
CONFIG_PACKAGE_kmod-swconfig=y
CONFIG_PACKAGE_kmod-appletalk=y
CONFIG_PACKAGE_kmod-atm=y
CONFIG_PACKAGE_kmod-bonding=y
CONFIG_PACKAGE_kmod-capi=y
CONFIG_PACKAGE_kmod-gre=y
CONFIG_PACKAGE_kmod-ip6-tunnel=y
CONFIG_PACKAGE_kmod-ipip=y
CONFIG_PACKAGE_kmod-ipsec=y
CONFIG_PACKAGE_kmod-ipsec4=y
CONFIG_PACKAGE_kmod-ipsec6=y
CONFIG_PACKAGE_kmod-iptunnel4=y
CONFIG_PACKAGE_kmod-iptunnel6=y
CONFIG_PACKAGE_kmod-ipv6=y
CONFIG_PACKAGE_kmod-isdn4linux=y
CONFIG_PACKAGE_kmod-misdn=y
CONFIG_PACKAGE_kmod-mp-alg=y
CONFIG_PACKAGE_kmod-ppp=y
CONFIG_PACKAGE_kmod-mppe=y
CONFIG_PACKAGE_kmod-pktgen=y
CONFIG_PACKAGE_kmod-ppp-synctty=y
CONFIG_PACKAGE_kmod-pppoa=y
CONFIG_PACKAGE_kmod-pppoe=y
CONFIG_PACKAGE_kmod-pppol2tp=y
CONFIG_PACKAGE_kmod-sched=y
CONFIG_PACKAGE_kmod-sit=y
CONFIG_PACKAGE_kmod-tun=y
CONFIG_PACKAGE_kmod-wprobe=y
CONFIG_PACKAGE_kmod-crc-ccitt=y
CONFIG_PACKAGE_kmod-crc16=y
CONFIG_PACKAGE_kmod-diag=y
CONFIG_PACKAGE_kmod-switch=y
CONFIG_PACKAGE_kmod-textsearch=y
CONFIG_PACKAGE_kmod-brcm-wl=y
CONFIG_PACKAGE_nas=y
CONFIG_PACKAGE_wl=y
CONFIG_PACKAGE_wlc=y
CONFIG_PACKAGE_kmod-usb-core=y
CONFIG_PACKAGE_kmod-video-core=y
CONFIG_PACKAGE_kmod-video-cpia2=y
CONFIG_PACKAGE_kmod-video-gspca-core=y
CONFIG_PACKAGE_kmod-video-gspca-conex=y
CONFIG_PACKAGE_kmod-video-gspca-etoms=y
CONFIG_PACKAGE_kmod-video-gspca-finepix=y
CONFIG_PACKAGE_kmod-video-gspca-gl860=y
CONFIG_PACKAGE_kmod-video-gspca-jeilinj=y
CONFIG_PACKAGE_kmod-video-gspca-m5602=y
CONFIG_PACKAGE_kmod-video-gspca-mars=y
CONFIG_PACKAGE_kmod-video-gspca-mr97310a=y
CONFIG_PACKAGE_kmod-video-gspca-ov519=y
CONFIG_PACKAGE_kmod-video-gspca-ov534=y
CONFIG_PACKAGE_kmod-video-gspca-pac207=y
CONFIG_PACKAGE_kmod-video-gspca-pac7311=y
CONFIG_PACKAGE_kmod-video-gspca-sn9c20x=y
CONFIG_PACKAGE_kmod-video-gspca-sonixb=y
CONFIG_PACKAGE_kmod-video-gspca-sonixj=y
CONFIG_PACKAGE_kmod-video-gspca-spca500=y
CONFIG_PACKAGE_kmod-video-gspca-spca501=y
CONFIG_PACKAGE_kmod-video-gspca-spca505=y
CONFIG_PACKAGE_kmod-video-gspca-spca506=y
CONFIG_PACKAGE_kmod-video-gspca-spca508=y
CONFIG_PACKAGE_kmod-video-gspca-spca561=y
CONFIG_PACKAGE_kmod-video-gspca-sq905=y
CONFIG_PACKAGE_kmod-video-gspca-sq905c=y
CONFIG_PACKAGE_kmod-video-gspca-stk014=y
CONFIG_PACKAGE_kmod-video-gspca-stv06xx=y
CONFIG_PACKAGE_kmod-video-gspca-sunplus=y
CONFIG_PACKAGE_kmod-video-gspca-t613=y
CONFIG_PACKAGE_kmod-video-gspca-tv8532=y
CONFIG_PACKAGE_kmod-video-gspca-vc032x=y
CONFIG_PACKAGE_kmod-video-gspca-zc3xx=y
CONFIG_PACKAGE_kmod-video-konica=y
CONFIG_PACKAGE_kmod-video-ov511=y
CONFIG_PACKAGE_kmod-video-ovcamchip=y
CONFIG_PACKAGE_kmod-video-pwc=y
CONFIG_PACKAGE_kmod-video-sn9c102=y
CONFIG_PACKAGE_kmod-video-uvc=y

# USB serial support
CONFIG_PACKAGE_kmod-usb-serial=y
CONFIG_PACKAGE_kmod-usb-serial-airprime=y
CONFIG_PACKAGE_kmod-usb-serial-ark3116=y
CONFIG_PACKAGE_kmod-usb-serial-belkin=y
CONFIG_PACKAGE_kmod-usb-serial-ch341=y
CONFIG_PACKAGE_kmod-usb-serial-cp210x=y
CONFIG_PACKAGE_kmod-usb-serial-cypress-m8=y
CONFIG_PACKAGE_kmod-usb-serial-ftdi=y
CONFIG_PACKAGE_kmod-usb-serial-ipw=y
CONFIG_PACKAGE_kmod-usb-serial-keyspan=y
CONFIG_PACKAGE_kmod-usb-serial-mct=y
CONFIG_PACKAGE_kmod-usb-serial-motorola-phone=y
CONFIG_PACKAGE_kmod-usb-serial-option=y
CONFIG_PACKAGE_kmod-usb-serial-oti6858=y
CONFIG_PACKAGE_kmod-usb-serial-pl2303=y
CONFIG_PACKAGE_kmod-usb-serial-sierrawireless=y
CONFIG_PACKAGE_kmod-usb-serial-visor=y

# USB Printer support
CONFIG_PACKAGE_kmod-usb-printer=y

# brcmf/smac support - will become modules not compiled into kernel
#CONFIG_PACKAGE_kmod-brcmfmac=y
#CONFIG_PACKAGE_kmod-brcmutil=y
#CONFIG_PACKAGE_kmod-lib-cordic=y
#CONFIG_PACKAGE_kmod-lib-crc8=y
#CONFIG_PACKAGE_kmod-brcmsmac=y
```

## plugins/example/Config.in
```kconfig
# DebWrt - Debian on Embedded devices
#
# Copyright (C) 2012 Johan van Zoomeren <amain@debwrt.net>
#
# This program is free software: you can redistribute it and/or modify
# it under the terms of the GNU General Public License as published by
# the Free Software Foundation, either version 3 of the License, or
# (at your option) any later version.
#
# This program is distributed in the hope that it will be useful,
# but WITHOUT ANY WARRANTY; without even the implied warranty of
# MERCHANTABILITY or FITNESS FOR A PARTICULAR PURPOSE.  See the
# GNU General Public License for more details.
#
# You should have received a copy of the GNU General Public License
# along with this program.  If not, see <http://www.gnu.org/licenses/>.

# Example plugin Config.in file
#
# The first config option is mandatory and is in the format
#
# PLUGIN_<NAME>_ENABLE   ( All in uppercase )
#
# If your plugin is adding support for a new target platform,
# please add deselect DO_CONF_TARGETS. This will disable the
# conventional DebWrt Target and Target Profile menu's and allows
# full override by the plugin.

config PLUGIN_EXAMPLE_VERSION
	string
	default "1.0"

config PLUGIN_EXAMPLE_UUID
	string
	default "128A6A00-29FA-11E2-81C1-0800200C9A66"

if PLUGIN_EXAMPLE

menu "Target Plugin Example Configuration"

config PLUGIN_EXAMPLE_ENABLE
	bool
	default y if PLUGIN_EXAMPLE
 	deselect HAS_SUBTARGETS
	deselect DO_CONF_TARGETS
	select TARGET_example
	select mipsel
	help
          Build firmware images for a...
	  .
	  Depending on the selected OPENWRT_BRANCH additional options become
	  available.
	  .
	  When selecting this plugin, some DebWrt defaults will be overriden. And
	  some menu's will become unavailable.

config TARGET_example
	bool
	default n

choice
	prompt "Target Profile"
	depends TARGET_example
	default TARGET_example_None

	config TARGET_example_None
        	bool "Subtarget A"
		depends TARGET_example
		help
		  Package set optimized for....


	config TARGET_example_subtarget2
		bool "Subtarget B"
		depends TARGET_example
		help
		  Package set optimized for...

	config TARGET_example_subtarget3
		bool "Subtarget C"
		depends TARGET_example
		help
		  Package set optimized for ...

	config TARGET_example_subtarget4
		bool "Subtarget B"
		depends TARGET_example
		help
		  Package set optimized for ...
endchoice

choice
	prompt "Plugin Version"
	depends TARGET_example
	default PLUGIN_EXAMPLE_VERSION_EXPERIMENTAL

	config PLUGIN_EXAMPLE_VERSION_EXPERIMENTAL
		bool "Experimental"
		depends TARGET_example
		depends OPENWRT_BRANCH_TRUNK
		select PLUGIN_EXAMPLE_DISABLE_OPENWRT_REVISION_MENU
		help
		  Use latest experimental patches for example.

	config PLUGIN_EXAMPLE_VERSION_AA
		bool "Attitude Adjustment"
		depends TARGET_example
		depends OPENWRT_BRANCH_ATTITUDE_ADJUSTMENT
		help
		  Use latest experimental patches for example.

	config PLUGIN_EXAMPLE_VERSION_2012-05-28T17-30
		bool "2012-05-28T17-30"
		depends TARGET_example
		depends OPENWRT_BRANCH_TRUNK
		help
		  Use patches from 2012-05-28T17-30 for example.

endchoice

# Disable DebWrt's OPENWRT_REVISON menu
config PLUGIN_EXAMPLE_DISABLE_OPENWRT_REVISION_MENU
	bool
	default n
	depends TARGET_example
	deselect DO_CONF_OPENWRT_REVISON

# Override DebWrt default values
if TARGET_example
config TARGET_BOARD
	string
	default "example"

config FLASH_IP
	string
	default "192.168.1.1"

config OPENWRT_REVISION
	string
	default "r31852" if PLUGIN_EXAMPLE_VERSION_EXPERIMENTAL
	default "HEAD"

config TARGET_IMAGE_NAME_TRX 
	string
	default "debwrt-firmware-example-squashfs.trx"

config DEFAULT_TARGET_OPTIMIZATION
	string
	default "-Os -pipe -mips32 -mtune=mips32 -funit-at-a-time"
endif

endmenu

endif
```
